## drivers/video/rockchip/kmpp/Kconfig
```kconfig
# SPDX-License-Identifier: (GPL-2.0+ OR MIT)

config ROCKCHIP_KMPP
	bool "kmpp"
	depends on CPU_RV1106
	select ROCKCHIP_MPP_OSAL
	select ROCKCHIP_DVBM
	default y
	help
	  rockchip kmpp
```

## drivers/video/rockchip/rockit/Kconfig
```kconfig
# SPDX-License-Identifier: (GPL-2.0+ OR MIT)

config ROCKCHIP_ROCKIT
	bool "rockit"
	depends on CPU_RV1106
	select ROCKCHIP_KMPP
	default y
	help
	  rockchip rockit
```
